#include <Wire.h>
#include <Adafruit_GFX.h>
#include <Adafruit_SSD1306.h>

#define SCREEN_WIDTH 128  // Lebar OLED
#define SCREEN_HEIGHT 64  // Tinggi OLED
#define OLED_RESET    -1  // Tidak menggunakan pin reset

Adafruit_SSD1306 display(SCREEN_WIDTH, SCREEN_HEIGHT, &Wire, OLED_RESET);

const int buzzerPin = A0;  // pin buzzer

// mata berkedip
int demo_mode = 1;
static const int max_animation_index = 8;
int current_animation_index = 0;

//reference state
int ref_eye_height = 40;
int ref_eye_width = 40;
int ref_space_between_eye = 10;
int ref_corner_radius = 10;
//current state of the eyes
int left_eye_height = ref_eye_height;
int left_eye_width = ref_eye_width;
int left_eye_x = 32;
int left_eye_y = 32;
int right_eye_x = 32+ref_eye_width+ref_space_between_eye;
int right_eye_y = 32;
int right_eye_height = ref_eye_height;
int right_eye_width = ref_eye_width;


// Nada frekuensi (Hz)
#define NOTE_C4  262
#define NOTE_D4  294
#define NOTE_E4  330
#define NOTE_F4  349
#define NOTE_G4  392
#define NOTE_A4  440
#define NOTE_B4  494
#define NOTE_C5  523
#define NOTE_D5  587
#define NOTE_E5  659
#define NOTE_F5  698
#define NOTE_G5  784
#define NOTE_C4  261
#define NOTE_D4  294
#define NOTE_E4  329
#define NOTE_F4  349
#define NOTE_G4  392
#define NOTE_A4  440

int melody[] = {
  NOTE_C4, NOTE_C4, NOTE_G4, NOTE_G4, NOTE_A4, NOTE_A4, NOTE_G4,
  NOTE_F4, NOTE_F4, NOTE_E4, NOTE_E4, NOTE_D4, NOTE_D4, NOTE_C4,
  
  NOTE_G4, NOTE_G4, NOTE_F4, NOTE_F4, NOTE_E4, NOTE_E4, NOTE_D4,
  NOTE_G4, NOTE_G4, NOTE_F4, NOTE_F4, NOTE_E4, NOTE_E4, NOTE_D4,
  
  NOTE_C4, NOTE_C4, NOTE_G4, NOTE_G4, NOTE_A4, NOTE_A4, NOTE_G4,
  NOTE_F4, NOTE_F4, NOTE_E4, NOTE_E4, NOTE_D4, NOTE_D4, NOTE_C4
};

// Durasi nada (4 artinya 1/4 beat; lebih kecil = lebih cepat)
int noteDurations[] = {
  4, 4, 4, 4, 4, 4, 2,
  4, 4, 4, 4, 4, 4, 2,
  
  4, 4, 4, 4, 4, 4, 2,
  4, 4, 4, 4, 4, 4, 2,
  
  4, 4, 4, 4, 4, 4, 2,
  4, 4, 4, 4, 4, 4, 2
};

const int melodyLength = sizeof(melody) / sizeof(melody[0]);
int noteIndex = 0;
unsigned long noteStartTime = 0;

// Bitmap asli (data lengkap harus sesuai hasil konversi 128x64)
const unsigned char epd_bitmap_11zon_resized [] PROGMEM = {
	0xff, 0xff, 0xff, 0xff, 0xbf, 0xff, 0xff, 0xff, 0xff, 0xff, 0xff, 0xff, 0xff, 0xff, 0xff, 0xff, 
	0xff, 0xff, 0xff, 0xff, 0xbf, 0xff, 0xff, 0xff, 0xff, 0xff, 0xff, 0xff, 0xff, 0xff, 0xff, 0xff, 
	0xff, 0xff, 0xff, 0xff, 0xbf, 0xff, 0xff, 0xff, 0xff, 0xff, 0xff, 0xff, 0xff, 0xff, 0xff, 0xff, 
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	0x00, 0x00, 0x00, 0x00, 0x00, 0x00, 0x00, 0x00, 0x00, 0x00, 0x00, 0x01, 0xff, 0x80, 0x00, 0x00
};

// Data dummy untuk bitmap kedua (epd_bitmap_fotbar1_11zon)
// Gantilah data ini dengan data hasil konversi gambar Anda!
const unsigned char epd_bitmap_fotbar1_11zon__1_ [] PROGMEM = {
	0x00, 0x00, 0x00, 0x00, 0xff, 0xc0, 0x07, 0xe1, 0xff, 0xc1, 0xf8, 0x00, 0x04, 0x0f, 0xff, 0xe0, 
	0x10, 0x00, 0x08, 0x00, 0x3f, 0xe3, 0xc7, 0xe1, 0xff, 0xc1, 0xf9, 0x00, 0x04, 0x07, 0xff, 0x80, 
	0x38, 0x00, 0xe8, 0x00, 0x00, 0x78, 0x77, 0xfc, 0x7f, 0xe0, 0xf9, 0xfd, 0x84, 0x03, 0xfe, 0x00, 
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	0x00, 0x00, 0x79, 0x9f, 0xe6, 0x00, 0xff, 0x0f, 0xe7, 0xe7, 0xf8, 0x00, 0x00, 0x2b, 0x80, 0x00
};

// Data dummy untuk bitmap ketiga (epd_bitmap_fotbar2_11zon)
// Gantilah data ini dengan data hasil konversi gambar Anda!
const unsigned char epd_bitmap_fotbar_11zon__1_ [] PROGMEM = {
	0xff, 0xff, 0xff, 0xff, 0xfb, 0xff, 0xf0, 0x00, 0x00, 0xff, 0x00, 0x00, 0x00, 0x00, 0x00, 0x00, 
	0xff, 0xff, 0xff, 0xff, 0xfb, 0xff, 0x80, 0x00, 0x00, 0x1c, 0x80, 0x00, 0x00, 0x00, 0x00, 0x00, 
	0xff, 0xff, 0xff, 0xff, 0xfb, 0xfe, 0x00, 0x00, 0x00, 0x07, 0x00, 0x00, 0x00, 0x00, 0x00, 0x00, 
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	0xff, 0xff, 0xfe, 0x3f, 0xff, 0xff, 0xff, 0xfe, 0x00, 0xe0, 0x00, 0x00, 0x00, 0x7f, 0xff, 0xff
};

const unsigned char epd_bitmap_fotbar_11zon__2_ [] PROGMEM = {
	0xff, 0xc3, 0xf8, 0x00, 0x00, 0x00, 0x00, 0x00, 0x00, 0x00, 0x00, 0x00, 0x3f, 0xff, 0xff, 0xff, 
	0xff, 0x87, 0xf8, 0x00, 0x00, 0x00, 0x00, 0x00, 0x00, 0x00, 0x00, 0x00, 0x3f, 0xff, 0xff, 0xff, 
	0xff, 0x87, 0xf8, 0x00, 0x00, 0x00, 0x00, 0x00, 0x00, 0x00, 0x00, 0x00, 0x3f, 0xff, 0xff, 0xff, 
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	0xf1, 0x00, 0x04, 0x1f, 0xc0, 0x00, 0x00, 0x00, 0x00, 0x00, 0x00, 0x00, 0x00, 0x00, 0x07, 0xff
};

const unsigned char epd_bitmap_fotbar_11zon__3_ [] PROGMEM = {
	0xff, 0xff, 0xff, 0xff, 0xff, 0xff, 0xff, 0xff, 0xff, 0xff, 0x70, 0x2f, 0xff, 0xf9, 0x00, 0x00, 
	0xff, 0xff, 0xff, 0xff, 0xff, 0xf2, 0x0f, 0xff, 0xff, 0xfe, 0xe4, 0x6f, 0xff, 0xff, 0x3c, 0x00, 
	0xff, 0xff, 0xff, 0xff, 0xff, 0xc6, 0x07, 0xff, 0xfe, 0xff, 0x38, 0x1f, 0xff, 0xe7, 0x80, 0x00, 
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	0x00, 0x00, 0x7b, 0x1f, 0xe0, 0x07, 0xe7, 0xc0, 0x01, 0xc0, 0x00, 0x00, 0x00, 0x00, 0x07, 0x8f
};

const unsigned char 	epd_bitmap_fotbar_11zon__4_ [] PROGMEM = {
	0x00, 0x00, 0x00, 0x00, 0x00, 0x00, 0x03, 0xff, 0xff, 0xff, 0x80, 0x00, 0x00, 0x7f, 0xff, 0xff, 
	0x00, 0x00, 0x00, 0x00, 0x00, 0x00, 0x03, 0xff, 0xff, 0xfe, 0x00, 0x00, 0x00, 0x1f, 0xff, 0xff, 
	0x00, 0x00, 0x00, 0x00, 0x00, 0x00, 0x07, 0xff, 0xff, 0xfc, 0x00, 0x00, 0x00, 0x0f, 0xff, 0xff, 
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	0xff, 0xff, 0xc0, 0xff, 0xff, 0x00, 0x00, 0x00, 0x00, 0x00, 0x00, 0x00, 0x00, 0x00, 0x1f, 0xff
};


// Deklarasi array pointer untuk bitmap yang akan ditampilkan
const unsigned char* bitmaps[] = {
  epd_bitmap_fotbar1_11zon__1_,
  epd_bitmap_fotbar_11zon__1_,
	epd_bitmap_11zon_resized,
	epd_bitmap_fotbar_11zon__2_,
	epd_bitmap_fotbar_11zon__3_,
	epd_bitmap_fotbar_11zon__4_
};

const int totalBitmaps = sizeof(bitmaps) / sizeof(bitmaps[0]);

// --- State Machine ---
// Tiga state: countdown, tampilkan bitmap, tampilkan pesan final
enum State {
  STATE_SHOW_MESSAGES,  // Tambahkan state baru
  STATE_COUNTDOWN,
  STATE_BITMAP,
  STATE_FINAL,
	STATE_LOOP_ANIMATION
};
State currentState = STATE_SHOW_MESSAGES;
unsigned long stateStartTime = 0;  // Untuk timing tiap state
int countdownNumber = 6;           // Mulai dari 3
int currentBitmapIndex = 0;        // Untuk iterasi bitmap

void drawHeart(int x, int y, int size) {
  int r = size / 4; // radius lingkaran
  // Tentukan pusat lingkaran kiri dan kanan
  int cx1 = x + r;
  int cy = y + r;
  int cx2 = x + size - r;
  
  // Gambar dua lingkaran
  display.fillCircle(cx1, cy, r, SSD1306_WHITE);
  display.fillCircle(cx2, cy, r, SSD1306_WHITE);
  
  // Gambar segitiga yang menyambung kedua lingkaran ke titik bawah hati
  display.fillTriangle(x, y + r, x + size, y + r, x + size/2, y + size, SSD1306_WHITE);
}


void playMelodyNonBlocking() {
  if (noteIndex < melodyLength) {
    int noteDuration = 1000 / noteDurations[noteIndex];
    // Mulai nada jika belum dimulai
    if (noteStartTime == 0) {
      noteStartTime = millis();
      tone(buzzerPin, melody[noteIndex], noteDuration);
    }
    // Ganti nada jika sudah waktunya
    if (millis() - noteStartTime >= noteDuration * 1.3) {
      noTone(buzzerPin);
      noteIndex++;
      noteStartTime = millis();
      if (noteIndex < melodyLength) {
        noteDuration = 1000 / noteDurations[noteIndex];
        tone(buzzerPin, melody[noteIndex], noteDuration);
      }
    }
  } else {
    noTone(buzzerPin);
  }
}

void showMessages() {
  int16_t x1, y1;
  uint16_t w1, h1;

  // 1. Tampilkan "Hi, Intan!"
  display.clearDisplay();
  display.setTextSize(1.7);
  display.setTextColor(WHITE);
  String text1 = "Hi, Intan!";
  display.getTextBounds(text1, 0, 0, &x1, &y1, &w1, &h1);
  int x1Pos = (SCREEN_WIDTH - w1) / 2;
  int y1Pos = (SCREEN_HEIGHT - h1) / 2;
  display.setCursor(x1Pos, y1Pos);
  display.println(text1);
  display.display();
  delay(3000);

  // 2. Tampilkan "i've"
  display.clearDisplay();
  display.setTextSize(1);
  String text2 = "i've";
  display.getTextBounds(text2, 0, 0, &x1, &y1, &w1, &h1);
  int x2Pos = (SCREEN_WIDTH - w1) / 2;
  int y2Pos = (SCREEN_HEIGHT - h1) / 2;
  display.setCursor(x2Pos, y2Pos);
  display.println(text2);
  display.display();
  delay(1000);

  // 3. Tampilkan "something"
  display.clearDisplay();
  String text3 = "something";
  display.getTextBounds(text3, 0, 0, &x1, &y1, &w1, &h1);
  int x3Pos = (SCREEN_WIDTH - w1) / 2;
  int y3Pos = (SCREEN_HEIGHT - h1) / 2;
  display.setCursor(x3Pos, y3Pos);
  display.println(text3);
  display.display();
  delay(1000);

  // 4. Tampilkan "for u....!"
  display.clearDisplay();
  String text4 = "for u....!";
  display.getTextBounds(text4, 0, 0, &x1, &y1, &w1, &h1);
  int x4Pos = (SCREEN_WIDTH - w1) / 2;
  int y4Pos = (SCREEN_HEIGHT - h1) / 2;
  display.setCursor(x4Pos, y4Pos);
  display.println(text4);
  display.display();
  delay(1000);

  // 5. Tampilkan "Siappp ?"
  display.clearDisplay();
  display.setTextSize(2);
  String text5 = "Siappp ?";
  display.getTextBounds(text5, 0, 0, &x1, &y1, &w1, &h1);
  int x5Pos = (SCREEN_WIDTH - w1) / 2;
  int y5Pos = (SCREEN_HEIGHT - h1) / 2;
  display.setCursor(x5Pos, y5Pos);
  display.println(text5);
  display.display();
  delay(1500);
}

void draw_eyes(bool update=true)
{
    display.clearDisplay();        
    //draw from center
    int x = int(left_eye_x-left_eye_width/2);
    int y = int(left_eye_y-left_eye_height/2);
    display.fillRoundRect(x,y,left_eye_width,left_eye_height,ref_corner_radius,SSD1306_WHITE);
    x = int(right_eye_x-right_eye_width/2);
    y = int(right_eye_y-right_eye_height/2);
    display.fillRoundRect(x,y,right_eye_width,right_eye_height,ref_corner_radius,SSD1306_WHITE);    
    if(update)
    {
      display.display();
    }
    
}

void center_eyes(bool update=true)
{
  //move eyes to the center of the display, defined by SCREEN_WIDTH, SCREEN_HEIGHT
  left_eye_height = ref_eye_height;
  left_eye_width = ref_eye_width;
  right_eye_height = ref_eye_height;
  right_eye_width = ref_eye_width;
  
  left_eye_x = SCREEN_WIDTH/2-ref_eye_width/2-ref_space_between_eye/2;
  left_eye_y = SCREEN_HEIGHT/2;
  right_eye_x = SCREEN_WIDTH/2+ref_eye_width/2+ref_space_between_eye/2;
  right_eye_y = SCREEN_HEIGHT/2;
  
  draw_eyes(update);
}

void blink(int speed=12)
{
  draw_eyes();
  
  
  for(int i=0;i<3;i++)
  {
    left_eye_height = left_eye_height-speed;
    right_eye_height = right_eye_height-speed;    
    draw_eyes();
    delay(1);
  }
  for(int i=0;i<3;i++)
  {
    left_eye_height = left_eye_height+speed;
    right_eye_height = right_eye_height+speed;
    
    draw_eyes();
    delay(1);
  }
}

void sleep()
{
  left_eye_height = 2;
  right_eye_height = 2;
  draw_eyes(true);  
}
void wakeup()
{
  
  sleep();
  
  for(int h=0; h <= ref_eye_height; h+=2)
  {
    left_eye_height = h;
    right_eye_height = h;
    draw_eyes(true);
  }
  

}

void happy_eye()
{
  center_eyes(false);
  //draw inverted triangle over eye lower part
  int offset = ref_eye_height/2;
  for(int i=0;i<10;i++)
  {
    display.fillTriangle(left_eye_x-left_eye_width/2-1, left_eye_y+offset, left_eye_x+left_eye_width/2+1, left_eye_y+5+offset, left_eye_x-left_eye_width/2-1,left_eye_y+left_eye_height+offset,SSD1306_BLACK);
    //display.fillRect(left_eye_x-left_eye_width/2-1, left_eye_y+5, left_eye_width+1, 20,SSD1306_BLACK);

    display.fillTriangle(right_eye_x+right_eye_width/2+1, right_eye_y+offset, right_eye_x-left_eye_width/2-1, right_eye_y+5+offset, right_eye_x+right_eye_width/2+1,right_eye_y+right_eye_height+offset,SSD1306_BLACK);
    //display.fillRect(right_eye_x-right_eye_width/2-1, right_eye_y+5, right_eye_width+1, 20,SSD1306_BLACK);  
    offset -= 2;
    display.display();
    delay(1);
  }
  
  
  display.display();
  delay(1000);
}

void saccade(int direction_x, int direction_y)
{
  //quick movement of the eye, no size change. stay at position after movement, will not move back,  call again with opposite direction
  //direction == -1 :  move left
  //direction == 1 :  move right
  
  int direction_x_movement_amplitude = 8;
  int direction_y_movement_amplitude = 6;
  int blink_amplitude = 8;

  for(int i=0;i<1;i++)
  {
    left_eye_x+=direction_x_movement_amplitude*direction_x;
    right_eye_x+=direction_x_movement_amplitude*direction_x;    
    left_eye_y+=direction_y_movement_amplitude*direction_y;
    right_eye_y+=direction_y_movement_amplitude*direction_y;    
    
    right_eye_height-=blink_amplitude;
    left_eye_height-=blink_amplitude;
    draw_eyes();
    delay(1);
  }
  
  for(int i=0;i<1;i++)
  {
    left_eye_x+=direction_x_movement_amplitude*direction_x;
    right_eye_x+=direction_x_movement_amplitude*direction_x;    
    left_eye_y+=direction_y_movement_amplitude*direction_y;
    right_eye_y+=direction_y_movement_amplitude*direction_y;

    right_eye_height+=blink_amplitude;
    left_eye_height+=blink_amplitude;

    draw_eyes();
    delay(1);
  }
  
}

void move_right_big_eye()
{
  move_big_eye(1);
}
void move_left_big_eye()
{
  move_big_eye(-1);
}

void move_big_eye(int direction)
{
  //direction == -1 :  move left
  //direction == 1 :  move right

  int direction_oversize = 1;
  int direction_movement_amplitude = 2;
  int blink_amplitude = 5;

  for(int i=0;i<3;i++)
  {
    left_eye_x+=direction_movement_amplitude*direction;
    right_eye_x+=direction_movement_amplitude*direction;    
    right_eye_height-=blink_amplitude;
    left_eye_height-=blink_amplitude;
    if(direction>0)
    {
      right_eye_height+=direction_oversize;
      right_eye_width+=direction_oversize;
    }else
    {
      left_eye_height+=direction_oversize;
      left_eye_width+=direction_oversize;
    }

    draw_eyes();
    delay(1);
  }
  for(int i=0;i<3;i++)
  {
    left_eye_x+=direction_movement_amplitude*direction;
    right_eye_x+=direction_movement_amplitude*direction;
    right_eye_height+=blink_amplitude;
    left_eye_height+=blink_amplitude;
    if(direction>0)
    {
      right_eye_height+=direction_oversize;
      right_eye_width+=direction_oversize;
    }else
    {
      left_eye_height+=direction_oversize;
      left_eye_width+=direction_oversize;
    }
    draw_eyes();
    delay(1);
  }

  delay(1000);

  for(int i=0;i<3;i++)
  {
    left_eye_x-=direction_movement_amplitude*direction;
    right_eye_x-=direction_movement_amplitude*direction;    
    right_eye_height-=blink_amplitude;
    left_eye_height-=blink_amplitude;
    if(direction>0)
    {
      right_eye_height-=direction_oversize;
      right_eye_width-=direction_oversize;
    }else
    {
      left_eye_height-=direction_oversize;
      left_eye_width-=direction_oversize;
    }
    draw_eyes();
    delay(1);
  }
  for(int i=0;i<3;i++)
  {
    left_eye_x-=direction_movement_amplitude*direction;
    right_eye_x-=direction_movement_amplitude*direction;    
    right_eye_height+=blink_amplitude;
    left_eye_height+=blink_amplitude;
    if(direction>0)
    {
      right_eye_height-=direction_oversize;
      right_eye_width-=direction_oversize;
    }else
    {
      left_eye_height-=direction_oversize;
      left_eye_width-=direction_oversize;
    }
    draw_eyes();
    delay(1);
  }


  center_eyes();


}

void launch_animation_with_index(int animation_index)
{

  

  if(animation_index>max_animation_index)
  {
    animation_index=8;
  }

  switch(animation_index)
      {
        case 0:
          wakeup();
          break;
        case 1:
          center_eyes(true);
          break;
        case 2:
          move_right_big_eye();
          break;
        case 3:
          move_left_big_eye();
          break;
        case 4:      
          blink(10);
          break;
        case 5:
          blink(20);
          break;
        case 6:
          happy_eye();      
          break;
        case 7:
          sleep();
          break;
        case 8:
          center_eyes(true);
          for(int i=0;i<20;i++)
          { 
            int dir_x = random(-1, 2);
            int dir_y = random(-1, 2);
            saccade(dir_x,dir_y);
            delay(1);
            saccade(-dir_x,-dir_y);
            delay(1);     
          }
          break;
          
      }
}




void setup() {
  pinMode(buzzerPin, OUTPUT);
  Wire.begin();
  if (!display.begin(SSD1306_SWITCHCAPVCC, 0x3C)) {
    while (1);
  }
  display.clearDisplay();
  stateStartTime = millis();
}

void loop() {
  unsigned long currentMillis = millis();
  
  if (currentState == STATE_SHOW_MESSAGES) {
    showMessages();
    currentState = STATE_COUNTDOWN;
    countdownNumber = 6;
    stateStartTime = millis();  // Reset waktu setelah showMessages
  }

  else if (currentState == STATE_COUNTDOWN) {
    if (currentMillis - stateStartTime >= 1000) {
      stateStartTime = currentMillis;
      countdownNumber--;
      display.clearDisplay();
      display.setTextSize(3);
      display.setTextColor(WHITE);
      
      int16_t x1, y1;
      uint16_t w, h;
      String countStr = String((countdownNumber > 0) ? countdownNumber : 0);
      display.getTextBounds(countStr, 0, 0, &x1, &y1, &w, &h);
      int x = (SCREEN_WIDTH - w) / 2;
      int y = (SCREEN_HEIGHT - h) / 2;
      display.setCursor(x, y);
      display.print(countStr);
      display.display();
      
      if (countdownNumber <= 0) {
        currentBitmapIndex = 0;
        currentState = STATE_BITMAP;
        stateStartTime = currentMillis;
      }
    }
  }

  else if (currentState == STATE_BITMAP) {
    display.clearDisplay();
    display.drawBitmap(0, 0, bitmaps[currentBitmapIndex], SCREEN_WIDTH, SCREEN_HEIGHT, WHITE);
    display.display();
    
    if (currentMillis - stateStartTime >= 3500) {
      stateStartTime = currentMillis;
      currentBitmapIndex++;
      if (currentBitmapIndex >= totalBitmaps) {
        currentState = STATE_FINAL;
        noteIndex = 0;
        noteStartTime = 0;
      }
    }
  }

  else if (currentState == STATE_FINAL) {
    display.clearDisplay();
    display.setTextSize(1.5);
    display.setTextColor(WHITE);
    display.setCursor(0, 0);
    display.println("Hey Intan,");
    display.println("Aku mungkin ga");
    display.println("suka matematika,");
    display.println("tapi aku");
    display.println("pasti suka kamu!");
    display.println();
    display.println();
    display.println("#selamat_wisuda");

    drawHeart(90, 40, 20);
    display.display();
    
    playMelodyNonBlocking();
    
    if (noteIndex >= melodyLength) {
      noTone(buzzerPin);
    	delay(5000);
    	current_animation_index = 0;
    	currentState = STATE_LOOP_ANIMATION;  // Masuk ke state animasi loop

      // Reset ke awal
      // currentState = STATE_SHOW_MESSAGES;
      // stateStartTime = millis();
    	}
  }
	else if (currentState == STATE_LOOP_ANIMATION) {
  launch_animation_with_index(current_animation_index++);

  if (current_animation_index > max_animation_index) {
    current_animation_index = 0;
  }

  delay(2000); // jeda antar animasi
	}
}