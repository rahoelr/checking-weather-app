#include <Wire.h>
#include <Adafruit_GFX.h>
#include <Adafruit_SSD1306.h>

#define SCREEN_WIDTH 128  // Lebar OLED
#define SCREEN_HEIGHT 64  // Tinggi OLED
#define OLED_RESET    -1  // Tidak menggunakan pin reset

Adafruit_SSD1306 display(SCREEN_WIDTH, SCREEN_HEIGHT, &Wire, OLED_RESET);

const int buzzerPin = A0;  // pin buzzer

// Nada frekuensi (Hz)
#define NOTE_C4  262
#define NOTE_D4  294
#define NOTE_E4  330
#define NOTE_F4  349
#define NOTE_G4  392
#define NOTE_A4  440
#define NOTE_B4  494
#define NOTE_C5  523
#define NOTE_D5  587
#define NOTE_E5  659
#define NOTE_F5  698
#define NOTE_G5  784

int melody[] = {
  NOTE_G4, NOTE_G4, NOTE_A4, NOTE_G4, NOTE_C5, NOTE_B4,
  NOTE_G4, NOTE_G4, NOTE_A4, NOTE_G4, NOTE_D5, NOTE_C5,
  NOTE_G4, NOTE_G4, NOTE_G5, NOTE_E5, NOTE_C5, NOTE_B4, NOTE_A4,
  NOTE_F5, NOTE_F5, NOTE_E5, NOTE_C5, NOTE_D5, NOTE_C5
};

int noteDurations[] = {
  4,4,2,2,2,1,
  4,4,2,2,2,1,
  4,4,2,2,2,2,1,
  4,4,2,2,2,1
};

const int melodyLength = sizeof(melody) / sizeof(melody[0]);
int noteIndex = 0;
unsigned long noteStartTime = 0;

// Bitmap asli (data lengkap harus sesuai hasil konversi 128x64)
const unsigned char epd_bitmap_11zon_resized [] PROGMEM = {
	0xff, 0xff, 0xff, 0xff, 0xff, 0xff, 0xff, 0xff, 0xff, 0xff, 0xff, 0xff, 0xff, 0xfd, 0xff, 0xff, 
	0xff, 0xff, 0xff, 0xff, 0xff, 0xff, 0xff, 0xff, 0xff, 0xff, 0xff, 0xff, 0xff, 0xf7, 0xff, 0xff, 
	0xff, 0xff, 0xff, 0xff, 0xff, 0xff, 0xff, 0xff, 0xff, 0xff, 0xff, 0xff, 0xff, 0xef, 0xff, 0xff, 
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	0x00, 0x00, 0x00, 0x00, 0x00, 0x00, 0x00, 0x00, 0x00, 0x61, 0xff, 0xfe, 0x00, 0x00, 0x00, 0x0f
};

// Data dummy untuk bitmap kedua (epd_bitmap_fotbar1_11zon)
// Gantilah data ini dengan data hasil konversi gambar Anda!
const unsigned char epd_bitmap_fotbar1_11zon__1_ [] PROGMEM = {
	0x00, 0x00, 0x00, 0x00, 0x60, 0x00, 0x00, 0x3f, 0xff, 0xff, 0xff, 0xff, 0xff, 0xff, 0xb7, 0xe8, 
	0x00, 0x00, 0x00, 0x00, 0x30, 0x00, 0x00, 0x07, 0xff, 0xff, 0xff, 0xff, 0xff, 0xfc, 0x00, 0x0c, 
	0x00, 0x00, 0x00, 0x00, 0x08, 0x00, 0x00, 0x07, 0xff, 0xff, 0xff, 0xff, 0xe4, 0xf8, 0x00, 0x00, 
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	0xff, 0xff, 0xff, 0xff, 0xff, 0xff, 0xff, 0xff, 0xff, 0xff, 0xf8, 0x00, 0x00, 0x00, 0x00, 0x7f
};


// Data dummy untuk bitmap ketiga (epd_bitmap_fotbar2_11zon)
// Gantilah data ini dengan data hasil konversi gambar Anda!
const unsigned char epd_bitmap_fotbar_11zon__1_ [] PROGMEM = {
	0x2f, 0xff, 0xff, 0xe1, 0xff, 0x3f, 0xff, 0x80, 0x0f, 0xfc, 0x1f, 0xff, 0x87, 0xff, 0xff, 0xff, 
	0x03, 0xff, 0xff, 0xe0, 0x1f, 0xff, 0xff, 0x80, 0x09, 0xc1, 0x0f, 0xe0, 0xf7, 0xff, 0xff, 0x8f, 
	0x03, 0xff, 0xff, 0xe0, 0x03, 0xff, 0xff, 0x80, 0x08, 0x01, 0x80, 0x3f, 0xfb, 0xff, 0xff, 0x9f, 
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	0x00, 0x00, 0x00, 0x00, 0x1e, 0xfe, 0x01, 0x00, 0x00, 0x00, 0x00, 0x07, 0xe0, 0x00, 0x00, 0x00
};


// Deklarasi array pointer untuk bitmap yang akan ditampilkan
const unsigned char* bitmaps[] = {
  epd_bitmap_11zon_resized,
  epd_bitmap_fotbar1_11zon__1_,
  epd_bitmap_fotbar_11zon__1_
};

const int totalBitmaps = sizeof(bitmaps) / sizeof(bitmaps[0]);

// --- State Machine ---
// Tiga state: countdown, tampilkan bitmap, tampilkan pesan final
enum State { STATE_COUNTDOWN, STATE_BITMAP, STATE_FINAL };
State currentState = STATE_COUNTDOWN;
unsigned long stateStartTime = 0;  // Untuk timing tiap state
int countdownNumber = 3;           // Mulai dari 3
int currentBitmapIndex = 0;        // Untuk iterasi bitmap

void drawHeart(int x, int y, int size) {
  int r = size / 4; // radius lingkaran
  // Tentukan pusat lingkaran kiri dan kanan
  int cx1 = x + r;
  int cy = y + r;
  int cx2 = x + size - r;
  
  // Gambar dua lingkaran
  display.fillCircle(cx1, cy, r, SSD1306_WHITE);
  display.fillCircle(cx2, cy, r, SSD1306_WHITE);
  
  // Gambar segitiga yang menyambung kedua lingkaran ke titik bawah hati
  display.fillTriangle(x, y + r, x + size, y + r, x + size/2, y + size, SSD1306_WHITE);
}

void playMelodyNonBlocking() {
  if (noteIndex < melodyLength) {
    int noteDuration = 1000 / noteDurations[noteIndex];
    // Mulai nada jika belum dimulai
    if (noteStartTime == 0) {
      noteStartTime = millis();
      tone(buzzerPin, melody[noteIndex], noteDuration);
    }
    // Ganti nada jika sudah waktunya
    if (millis() - noteStartTime >= noteDuration * 1.3) {
      noTone(buzzerPin);
      noteIndex++;
      noteStartTime = millis();
      if (noteIndex < melodyLength) {
        noteDuration = 1000 / noteDurations[noteIndex];
        tone(buzzerPin, melody[noteIndex], noteDuration);
      }
    }
  } else {
    noTone(buzzerPin);
  }
}


void setup() {
	pinMode(buzzerPin, OUTPUT);
  Wire.begin(); // Inisialisasi I2C: SDA (A4), SCL (A5)
  if (!display.begin(SSD1306_SWITCHCAPVCC, 0x3C)) {
    while (1);
  }
  display.clearDisplay();
  display.display();

	stateStartTime = millis();
}

void loop() {
	unsigned long currentMillis = millis();
  // --- STATE_COUNTDOWN ---
  if (currentState == STATE_COUNTDOWN) {
    // Update countdown setiap 1000 ms
    if (currentMillis - stateStartTime >= 1000) {
      stateStartTime = currentMillis;
      countdownNumber--;
      display.clearDisplay();
      display.setTextSize(3);
      display.setTextColor(WHITE);
      
      int16_t x1, y1;
      uint16_t w, h;
      String countStr = String((countdownNumber > 0) ? countdownNumber : 0);
      display.getTextBounds(countStr, 0, 0, &x1, &y1, &w, &h);
      int x = (SCREEN_WIDTH - w) / 2;
      int y = (SCREEN_HEIGHT - h) / 2;
      display.setCursor(x, y);
      display.print(countStr);
      display.display();
      
      if (countdownNumber <= 0) {
        // Reset indeks bitmap, lalu pindah ke STATE_BITMAP
        currentBitmapIndex = 0;
        currentState = STATE_BITMAP;
        stateStartTime = currentMillis;
      }
    }
  }
  // --- STATE_BITMAP ---
  else if (currentState == STATE_BITMAP) {
    // Tampilkan bitmap sesuai indeks saat ini
    display.clearDisplay();
    display.drawBitmap(0, 0, bitmaps[currentBitmapIndex], SCREEN_WIDTH, SCREEN_HEIGHT, WHITE);
    display.display();
    
    // Setelah 3000 ms, tampilkan bitmap berikutnya
    if (currentMillis - stateStartTime >= 3000) {
      stateStartTime = currentMillis;
      currentBitmapIndex++;
      if (currentBitmapIndex >= totalBitmaps) {
        // Jika semua bitmap sudah ditampilkan, pindah ke STATE_FINAL
        currentState = STATE_FINAL;
        noteIndex = 0;
        noteStartTime = 0;
      }
    }
  }
  // --- STATE_FINAL ---
  else if (currentState == STATE_FINAL) {
    // Tampilkan pesan final: teks + gambar hati
    display.clearDisplay();
    display.setTextSize(1.5);
    display.setTextColor(WHITE);
    display.setCursor(0, 0);
    display.println("i really like");
    display.println("everything about u,");
    display.println("u can do anything,");
    display.println("i'm pround to have u");
    // Gambar hati di pojok kanan bawah (ukuran 20, koordinat (90,40))
    drawHeart(90, 40, 20);
    display.display();
    
    // Mainkan lagu Happy Birthday secara non-blocking
    playMelodyNonBlocking();
    
    // Setelah lagu selesai, tunggu 5 detik dan reset siklus
    if (noteIndex >= melodyLength) {
      noTone(buzzerPin);
      delay(5000);
      // Reset state machine ke STATE_COUNTDOWN
      currentState = STATE_COUNTDOWN;
      countdownNumber = 3;
      stateStartTime = millis();
    }
  }
}